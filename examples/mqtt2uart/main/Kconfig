## examples/mqtt2uart/main/Kconfig
```kconfig
menu "mqtt2uart Configuration"

    config APP_PROJECT_VER
        string "Project Version"
        default "esp32c3:3.0.0"
        help
            Version string sent to SSCMA via AT+WIFIVER.

endmenu
```

## examples/mqtt2uart/sdkconfig.defaults
```kconfig
CONFIG_IDF_TARGET=esp32c3
CONFIG_ESPTOOLPY_FLASHSIZE_4MB=y
CONFIG_ESPTOOLPY_HEADER_FLASHSIZE_UPDATE=y
CONFIG_FREERTOS_HZ=1000
CONFIG_ESP_CONSOLE_UART_DEFAULT=y
# CONFIG_ESP_CONSOLE_USB_SERIAL_JTAG is not set
# CONFIG_ESP_CONSOLE_SECONDARY_NONE is not set
# CONFIG_ESP_CONSOLE_UART_CUSTOM is not set
# CONFIG_ESP_CONSOLE_NONE is not set
```
